## br2-external/Config.in
```kconfig
source "$BR2_EXTERNAL_R36LLM_PATH/package/prism-llama-cpp/Config.in"
source "$BR2_EXTERNAL_R36LLM_PATH/package/r36llm-app/Config.in"
```

## br2-external/configs/r36llm_defconfig
```kconfig
BR2_DL_DIR="/home/br/work/dl"
BR2_CCACHE=y
BR2_CCACHE_DIR="/home/br/work/ccache"
BR2_aarch64=y
BR2_cortex_a35=y
BR2_TOOLCHAIN_BUILDROOT_GLIBC=y
BR2_KERNEL_HEADERS_VERSION=y
BR2_DEFAULT_KERNEL_VERSION="4.4.189"
BR2_PACKAGE_HOST_LINUX_HEADERS_CUSTOM_4_4=y
# Linux 4.4 predates LICENSES/; ./COPYING selects its version-specific hash.
BR2_PACKAGE_HOST_LINUX_HEADERS_LICENSE_FILES="./COPYING"
BR2_GLOBAL_PATCH_DIR="$(BR2_EXTERNAL_R36LLM_PATH)/patches"
BR2_TOOLCHAIN_BUILDROOT_CXX=y
BR2_GCC_ENABLE_OPENMP=y
BR2_INIT_BUSYBOX=y
BR2_TARGET_GENERIC_HOSTNAME="r36llm"
BR2_ROOTFS_DEVICE_CREATION_DYNAMIC_MDEV=y
BR2_TARGET_GENERIC_ROOT_PASSWD="r36llm"
BR2_ROOTFS_OVERLAY="$(BR2_EXTERNAL_R36LLM_PATH)/board/r36llm/overlay"
BR2_ROOTFS_POST_BUILD_SCRIPT="$(BR2_EXTERNAL_R36LLM_PATH)/board/r36llm/post-build.sh"
BR2_ROOTFS_POST_IMAGE_SCRIPT="$(BR2_EXTERNAL_R36LLM_PATH)/board/r36llm/post-image.sh"
BR2_PACKAGE_BUSYBOX_CONFIG_FRAGMENT_FILES="$(BR2_EXTERNAL_R36LLM_PATH)/board/r36llm/busybox.fragment"
BR2_PACKAGE_DROPBEAR=y
BR2_TARGET_ROOTFS_CPIO=y
BR2_TARGET_ROOTFS_CPIO_GZIP=y
# BR2_TARGET_ROOTFS_TAR is not set
BR2_PACKAGE_HOST_UBOOT_TOOLS=y
BR2_PACKAGE_PRISM_LLAMA_CPP=y
BR2_PACKAGE_R36LLM_APP=y
BR2_PACKAGE_DOSFSTOOLS=y
BR2_PACKAGE_DOSFSTOOLS_MKFS_FAT=y
BR2_PACKAGE_UTIL_LINUX=y
BR2_PACKAGE_UTIL_LINUX_BINARIES=y
BR2_PACKAGE_HOST_GENIMAGE=y
BR2_PACKAGE_HOST_DOSFSTOOLS=y
BR2_PACKAGE_HOST_MTOOLS=y
```

## br2-external/package/prism-llama-cpp/Config.in
```kconfig
config BR2_PACKAGE_PRISM_LLAMA_CPP
	bool "prism-llama-cpp"
	depends on BR2_INSTALL_LIBSTDCPP
	depends on BR2_TOOLCHAIN_HAS_THREADS
	depends on BR2_TOOLCHAIN_GCC_AT_LEAST_9
	depends on !BR2_TOOLCHAIN_USES_UCLIBC || !BR2_STATIC_LIBS
	depends on BR2_USE_WCHAR
	select BR2_PACKAGE_LIBEXECINFO if BR2_TOOLCHAIN_USES_UCLIBC
	help
	  PrismML llama.cpp with Bonsai quantization support and CLI tools.

	  https://github.com/PrismML-Eng/llama.cpp

comment "prism-llama-cpp needs C++, wchar, threads, and gcc >= 9"
	depends on !BR2_INSTALL_LIBSTDCPP || !BR2_USE_WCHAR || !BR2_TOOLCHAIN_HAS_THREADS || !BR2_TOOLCHAIN_GCC_AT_LEAST_9

comment "prism-llama-cpp needs dynamic libraries with uClibc"
	depends on BR2_TOOLCHAIN_USES_UCLIBC && BR2_STATIC_LIBS
```

## br2-external/package/r36llm-app/Config.in
```kconfig
config BR2_PACKAGE_R36LLM_APP
	bool "r36llm-app"
	depends on BR2_PACKAGE_PRISM_LLAMA_CPP
	help
	  Gamepad-controlled framebuffer chat application for the R36S.
```
